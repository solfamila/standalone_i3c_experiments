RESet
SYStem.RESet
SYStem.CPU IMXRT595-CM33
IF COMBIPROBE()||UTRACE()
(
  SYStem.CONFIG.CONNECTOR MIPI20T
)
SYStem.Option DUALPORT ON
SYStem.MemAccess DAP
SYStem.JtagClock 10MHz
ETM.OFF
ITM.OFF
SYStem.Up

Data.LOAD.Elf "/Users/foxy/Downloads/tts/standalone_i3c_experiments/master_i3c_sdma_seed_tail_len_sweep/_build/master/evkmimxrt595_ezhb.axf"

ENDDO